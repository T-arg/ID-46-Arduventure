#ifndef WORLDDATA_H
#define WORLDDATA_H
/// The below code was generated by
/// the Arduventure World Editor
/// created by Gavin Atkin 2016-2017
/// and rearranged + optimized by JO3RI

#include "globals.h"
#include "enemies.h"

#define TILE_FLOOR                    8
#define TILE_STAIRS                   9
#define TILE_ROCK                     31
#define TILE_WALL                     47
#define TILE_BLACK                    55
#define TILE_SIGN                     56
#define TILE_CLOSED_CHEST             57
#define TILE_OPENED_CHEST             58

byte lastRegion;                                 // the region getChunk() found for the last chunk it looked at

// region of a chunk: the first rectangle in regions[] that holds it
byte getRegion(byte chunk_pos_x, byte chunk_pos_y)
{
  for (byte i = 0; i < TOTAL_REGIONS; i++)
  {
    byte rx = pgm_read_byte(regions + i * 4);
    byte ry = pgm_read_byte(regions + 1 + i * 4);
    if (chunk_pos_x >= rx && chunk_pos_x - rx < pgm_read_byte(regions + 2 + i * 4) &&
        chunk_pos_y >= ry && chunk_pos_y - ry < pgm_read_byte(regions + 3 + i * 4)) return i;
  }
  return REGION_FOREST;
}

void checkRegion()
{
  player.currentRegion = getRegion(playerReducedX, playerReducedY);
  changeSong(player.currentRegion);
}

bool getChunkBit(byte chunk_x, byte chunk_y)
{
  byte x = chunk_x / 8;           // 8 is number of chunks per byte
  byte y = chunk_y * 4;           // 4 is number of bytes per row
  return (pgm_read_byte(solid_map + x + y) & _BV(chunk_x % 8)) > 0;
}

// the chunks that were placed one by one (houses, trees, shops ...), sorted on position
// bits 0 - 11: chunk x + 32 * chunk y / bits 12 - 14: index in specialChunkType
#define SPECIAL_CHUNKS               43
const uint16_t PROGMEM specialChunks[] =
{
  0x4006, 0x5021, 0x402A, 0x602B, 0x103B, 0x503D, 0x1054, 0x30AB,
  0x30B4, 0x30C0, 0x60D1, 0x10FD, 0x3138, 0x1154, 0x3161, 0x3170,
  0x417B, 0x318A, 0x31E5, 0x31ED, 0x6201, 0x3203, 0x1208, 0x3232,
  0x523A, 0x325D, 0x3273, 0x3277, 0x028F, 0x42C5, 0x32CC, 0x52CE,
  0x32E1, 0x42F2, 0x62F4, 0x3308, 0x7321, 0x1322, 0x134B, 0x3369,
  0x3371, 0x338E, 0x23F3
};
const byte PROGMEM specialChunkType[] = { 146, 162, 167, 170, 171, 172, 173, 174 };   // 128 + chunk number

// the chunk of each region: { open, solid }, an open chunk with bit 7 set takes the 4 neighbours into account
const byte PROGMEM regionChunk[] =
{
  16, 31,                   // REGION_FIELDS_SWAMP
  21, 31,                   // REGION_SWAMP_FOREST
  32, 31,                   // REGION_FOREST_CANYON
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  35, 34,                   // REGION_APPLE_FARM
  0x80 + 16, 31,            // REGION_YOUR_GARDEN
  0x80 + 16, 31,            // REGION_FIELDS
  0x80 + 16, 31,            // REGION_SWAMP
  0x80 + 16, 31,            // REGION_FOREST
  0x80, 15,                 // REGION_CANYONS
  36, 47,                   // REGION_HOUSE_INTERIOR
  37, 47,                   // REGION_INN_INTERIOR
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  33, 33,                   // REGION_ALL_BLACK
};

// getChunk
// Returns a value greater than 127 if the chunk was specifically placed.
// If the chunk is part of a region the returned value will be
// less than 128 (and lastRegion is its region).
// To get the actual chunk value of a specific chunk, AND (&) the returned
// chunk with 0x7F (B01111111)
byte getChunk(byte chunk_pos_x, byte chunk_pos_y)
{
  uint16_t position = chunk_pos_x + chunk_pos_y * 32;
  for (byte i = 0; i < SPECIAL_CHUNKS; i++)
  {
    uint16_t special = pgm_read_word(&specialChunks[i]);
    if ((special & 0x0FFF) == position) return pgm_read_byte(&specialChunkType[special >> 12]);
    if ((special & 0x0FFF) > position) break;
  }
  lastRegion = getRegion(chunk_pos_x, chunk_pos_y);
  bool solid = getChunkBit(chunk_pos_x, chunk_pos_y);
  byte chunk = pgm_read_byte(&regionChunk[lastRegion * 2 + solid]);
  if (chunk & 0x80)
  {
    chunk &= 0x7F;
    chunk += getChunkBit(chunk_pos_x + 1, chunk_pos_y);
    chunk += getChunkBit(chunk_pos_x, chunk_pos_y - 1) << 1;
    chunk += getChunkBit(chunk_pos_x - 1, chunk_pos_y) << 2;
    chunk += getChunkBit(chunk_pos_x, chunk_pos_y + 1) << 3;
  }
  return chunk;
}

// tile number i (x + 6 * y) of chunk number chunk, out of the packed chunks[]
byte getChunkTile(byte chunk, byte i)
{
  byte bits = 6;
  uint16_t pos = 5148 + (chunk - 32) * 216;
  if (chunk < 32)
  {
    bits = 4;
    pos = 2700 + (chunk - 15) * 144;
    if (chunk < 15)
    {
      bits = 5;
      pos = chunk * 180;
    }
  }
  pos += i * bits;
  uint16_t data = pgm_read_byte(chunks + (pos >> 3)) | ((uint16_t)pgm_read_byte(chunks + (pos >> 3) + 1) << 8);
  byte tile = (data >> (pos & 7)) & ((1 << bits) - 1);
  if (bits == 4 && tile > 7) tile += 24;
  return tile;
}

// the tiles that are not part of a chunk: x, y and what it is
// bits 0 - 2: the bit in gameTriggers / bit 3: gameTriggers[2] instead of [3]
// bits 4 - 5: 0 sign / 1 rock until the bit is set (amulet used) / 2 chest (opened when the bit is set) / 3 chest of the cave you are in
#define SPECIAL_TILES                13
#define SPECIAL_SIGN                 0x00
#define SPECIAL_ROCK                 0x10
#define SPECIAL_CHEST                0x20
#define SPECIAL_CAVE                 0x30
const byte PROGMEM specialTiles[] =
{
  89,   8, SPECIAL_SIGN,
  182, 95, SPECIAL_SIGN,
  93, 124, SPECIAL_SIGN,
  11, 157, SPECIAL_SIGN,
  93, 123, SPECIAL_ROCK  | 0,                  // FIELDS - SWAMP    AMULET OF WATER
  183, 95, SPECIAL_ROCK  | 1,                  // SWAMP - FOREST    AMULET OF LEAFS
  89,   9, SPECIAL_ROCK  | 2,                  // FOREST - CANYONS  AMULET OF FIRE
  153, 26, SPECIAL_CHEST | 6,                  // chest in forest middle
  147, 98, SPECIAL_CHEST | 5,                  // chest in swamp north
  67,  92, SPECIAL_CHEST | 4,                  // chest in fields
  69,  20, SPECIAL_CHEST | 7,                  // chest in north canyons
  139, 181, SPECIAL_CHEST | 8 | 4,             // chest in the house
  44, 188, SPECIAL_CAVE,                       // chest in the cave
};

// tiles 0 - 7 of the fields (and your garden) and of the swamp
const byte PROGMEM tileRemap[] = { 0, 1, 0, 5, 5, 5, 6, 2,  12, 10, 10, 5, 10, 5, 6, 10 };

byte getTileID(uint16_t world_pos_x, uint16_t world_pos_y)
{
  if (world_pos_x > 3056 || world_pos_y > 3136) return TILE_ROCK;
  byte tile_x = world_pos_x >> 4;
  byte tile_y = world_pos_y >> 4;
  for (byte i = 0; i < SPECIAL_TILES; i++)
  {
    if (pgm_read_byte(&specialTiles[i * 3]) == tile_x && pgm_read_byte(&specialTiles[i * 3 + 1]) == tile_y)
    {
      byte what = pgm_read_byte(&specialTiles[i * 3 + 2]);
      byte type = what & 0x30;
      if (type == SPECIAL_SIGN) return TILE_SIGN;
      byte bit = what & 7;
      byte triggers = player.gameTriggers[(what & 8) ? 2 : 3];
      if (type == SPECIAL_CAVE) triggers = player.gameTriggers[player.lastDoor / 8], bit = player.lastDoor % 8;
      bool set = bitRead(triggers, bit);
      if (type != SPECIAL_ROCK) return set ? TILE_OPENED_CHEST : TILE_CLOSED_CHEST;
      if (!set) return TILE_ROCK;
      break;
    }
  }

  byte chunk = getChunk(world_pos_x / 96, world_pos_y / 96);
  byte tile = getChunkTile(chunk & 0x7F, ((world_pos_x % 96) >> 4) + ((world_pos_y % 96) >> 4) * 6);
  if (chunk < 128 && (lastRegion == REGION_SWAMP || lastRegion == REGION_FIELDS || lastRegion == REGION_YOUR_GARDEN))
  {
    byte swamp = (lastRegion == REGION_SWAMP);
    if (tile > 30) tile = swamp ? 14 : 32;
    else if (tile < 8) tile = pgm_read_byte(&tileRemap[swamp * 8 + tile]);
  }

  if (tile > 9 && tile < 16) tile += (tile & 1) ? -frameBoolean : frameBoolean;     // water and leafs move

  return tile;
}

bool getSolid(uint16_t world_x, uint16_t world_y)
{
  return (getTileID(world_x, world_y) >= 14);
}

void drawTiles()
{
  //for (int x = 0; x <= 128; x += 16)
  for (byte x = 128; x <= 128; x -= 16)
  {
    //for (int y = 0; y <= 64; y += 16)
    for (byte y = 64; y <= 64; y -= 16)
    {
      byte tile = getTileID(camX + x, camY + y);
      sprites.drawOverwrite((((camX >> 4) << 4) + x) - camX, (((camY >> 4) << 4) + y) - camY, tileSheet, tile);
    }
  }
}

void checkDoors()
{
  if (!(playerDirection & 0B00000001)) //WALKING NORTH OR SOUTH
  {
    for (byte i = 0; i < TOTAL_DOORS; i++)
    {
      if ((uint16_t)(player.x + 3 - 16 * pgm_read_byte(&doors[i * 2])) < 10 && (uint16_t)(player.y - 16 * pgm_read_byte(&doors[(i * 2) + 1])) < 10)
      {
        if (playerDirection == FACING_NORTH) player.lastDoor = i;
        gameState = WALKING_THROUGH_DOOR;
        return;
      }
    }
  }
}


#endif
